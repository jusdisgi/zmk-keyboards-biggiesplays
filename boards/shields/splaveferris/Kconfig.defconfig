## boards/shields/splaveferris/Kconfig.defconfig
```kconfig
# Copyright (c) 2020 The ZMK Contributors
# SPDX-License-Identifier: MIT

if SHIELD_BIGGIESPLAYS_LEFT

config ZMK_KEYBOARD_NAME
    default "BiggieSplays"

config ZMK_SPLIT_ROLE_CENTRAL
    default y

endif

if SHIELD_BIGGIESPLAYS_LEFT || SHIELD_BIGGIESPLAYS_RIGHT

config ZMK_SPLIT
    default y

endif
```

## boards/shields/splaveferris/Kconfig.shield
```kconfig
# Copyright (c) 2020 The ZMK Contributors
# SPDX-License-Identifier: MIT

config SHIELD_BIGGIESPLAYS_LEFT
    def_bool $(shields_list_contains,biggiesplays_left)

config SHIELD_BIGGIESPLAYS_RIGHT
    def_bool $(shields_list_contains,biggiesplays_right)
```
